#include "realme-msm8953-camera-sensor-mtp-S88069AA1.dtsi"
#include "realme-msm8953-mdss-panels.dtsi"
#include "realme-msm8953-mtp.dtsi"
#include "realme-msm8953-pinctrl.dtsi"
#include "realme-msm8953-regulator.dtsi"
#include "realme-msm8953.dtsi"
#include "realme-pm8953.dtsi"
#include "realme-pmi632.dtsi"
#include "realme-sdm450-camera-sensor-mtp-S88051AA1.dtsi"
#include "realme-sdm450-pmi632-mtp-s3-S88051AA1.dtsi"
#include "realme-sdm450-pmi632.dtsi"
